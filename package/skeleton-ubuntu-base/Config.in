## package/skeleton-ubuntu-base/Config.in
```kconfig
config BR2_PACKAGE_SKELETON_UBUNTU_BASE
	bool

config BR2_PACKAGE_PROVIDES_SKELETON
	default "skeleton-ubuntu-base" if BR2_PACKAGE_SKELETON_UBUNTU_BASE
```
